## drivers/firmware/tegra/Kconfig
```kconfig
# SPDX-License-Identifier: GPL-2.0-only
menu "Tegra firmware driver"

config TEGRA_IVC
	bool "Tegra IVC protocol"
	depends on ARCH_TEGRA
	help
	  IVC (Inter-VM Communication) protocol is part of the IPC
	  (Inter Processor Communication) framework on Tegra. It maintains the
	  data and the different communication channels in SysRAM or RAM and
	  keeps the content is synchronization between host CPU and remote
	  processors.

config TEGRA_BPMP
	bool "Tegra BPMP driver"
	depends on ARCH_TEGRA && TEGRA_HSP_MBOX && TEGRA_IVC
	help
	  BPMP (Boot and Power Management Processor) is designed to off-loading
	  the PM functions which include clock/DVFS/thermal/power from the CPU.
	  It needs HSP as the HW synchronization and notification module and
	  IVC module as the message communication protocol.

	  This driver manages the IPC interface between host CPU and the
	  firmware running on BPMP.

endmenu

menu "Tegra BPMP Driver"

config NV_TEGRA_BPMP
        bool "Tegra BPMP driver (Downstream version)"
        default n
        select NV_TEGRA_IVC
        select TEGRA_HSP
        help
          Manages firmware running on Tegra BPMP

          This driver is a downstream version and there is a newer variant
          available in modern kernels.

config BPMP_DEBUGFS_MOUNT_ON_BOOT
        bool "Mount the BPMP debug fs on boot"
        default y
        depends on DEBUG_FS && NV_TEGRA_BPMP
        help
          Disable this if you don't want to mount the BPMP debug fs by default
          on boot.

          Note disabling this will save some boot time. BPMP debugfs still can
          be mounted after the boot.

endmenu
```

## drivers/thermal/tegra/Kconfig
```kconfig
# SPDX-License-Identifier: GPL-2.0-only
menu "NVIDIA Tegra thermal drivers"
depends on ARCH_TEGRA || COMPILE_TEST

config TEGRA_SOCTHERM
	tristate "Tegra SOCTHERM thermal management"
	help
	  Enable this option for integrated thermal management support on NVIDIA
	  Tegra systems-on-chip. The driver supports four thermal zones
	  (CPU, GPU, MEM, PLLX). Cooling devices can be bound to the thermal
	  zones to manage temperatures. This option is also required for the
	  emergency thermal reset (thermtrip) feature to function.

config TEGRA_BPMP_THERMAL
	tristate "Tegra BPMP thermal sensing"
	depends on TEGRA_BPMP || COMPILE_TEST
	help
	  Enable this option for support for sensing system temperature of NVIDIA
	  Tegra systems-on-chip with the BPMP coprocessor (Tegra186).

config TEGRA30_TSENSOR
	tristate "Tegra30 Thermal Sensor"
	depends on ARCH_TEGRA_3x_SOC || COMPILE_TEST
	help
	  Enable this option to support thermal management of NVIDIA Tegra30
	  system-on-chip.

config TEGRA_AOTAG
        bool "Tegra Always-On-Thermal-Alert-Generator"
        help
          Support for Tegra Always-On thermal Alert Generator

config TEGRA_TJ_THERMAL
        bool "Tegra Tj temperature"
        default y
        help
          Enable this option to read the temperature of hottest spot on Tegra
          SoC. The driver can be configured (via device-tree) to account for
          multiple thermal zones and the corresponding configurable hotspot
          offsets, and, report the maximum temperature from the same, hence,
          representing the hottest point on the chip.

config TEGRA_CORE_CAPS
        tristate "Tegra core DVFS thermal limits"
        depends on TEGRA_DVFS
        help
          This config enables a cooling device that enforces VF limits on the
          core voltage rail.

config TEGRA_DFLL_CAPS
        tristate "Tegra DFLL DVFS thermal limits"
        depends on TEGRA_DVFS
        help
          This config enables a cooling device that enforces VF limits on the
          cpu DFLL clock.

endmenu
```
